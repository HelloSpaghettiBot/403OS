## external/Config.in
```kconfig
source "$BR2_EXTERNAL_SURFACE_PATH/package/surface-sdl3/Config.in"
source "$BR2_EXTERNAL_SURFACE_PATH/package/surface-shell/Config.in"
source "$BR2_EXTERNAL_SURFACE_PATH/package/surface-rotation/Config.in"
source "$BR2_EXTERNAL_SURFACE_PATH/package/surface-emulators/Config.in"
source "$BR2_EXTERNAL_SURFACE_PATH/package/surface-tailscale/Config.in"
source "$BR2_EXTERNAL_SURFACE_PATH/package/surface-moonlight/Config.in"
source "$BR2_EXTERNAL_SURFACE_PATH/package/surface-wine64/Config.in"
source "$BR2_EXTERNAL_SURFACE_PATH/package/surface-umu/Config.in"
```

## external/configs/surface_go1_defconfig
```kconfig
BR2_x86_64=y
BR2_TOOLCHAIN_EXTERNAL=y
BR2_TOOLCHAIN_EXTERNAL_BOOTLIN=y
BR2_TOOLCHAIN_EXTERNAL_BOOTLIN_X86_64_GLIBC_STABLE=y
BR2_JLEVEL=10
BR2_REPRODUCIBLE=y
BR2_TARGET_TZ_INFO=y
BR2_TARGET_TZ_ZONELIST="northamerica etcetera"
BR2_TARGET_LOCALTIME="America/Los_Angeles"
BR2_WGET="wget --passive-ftp -nd -t 2 --timeout=30 --inet4-only"
BR2_GLOBAL_PATCH_DIR="$(BR2_EXTERNAL_SURFACE_PATH)/patches"
BR2_TARGET_GENERIC_HOSTNAME="surface-go"
BR2_TARGET_GENERIC_ISSUE="Surface Go Gaming OS development foundation"
BR2_ROOTFS_DEVICE_CREATION_DYNAMIC_EUDEV=y
# BR2_TARGET_GENERIC_GETTY is not set
BR2_SYSTEM_DHCP="eth0"
BR2_ROOTFS_OVERLAY="$(BR2_EXTERNAL_SURFACE_PATH)/board/surface-go1/overlay"
BR2_PACKAGE_BUSYBOX_CONFIG_FRAGMENT_FILES="$(BR2_EXTERNAL_SURFACE_PATH)/board/surface-go1/busybox.fragment"
BR2_ROOTFS_USERS_TABLES="$(BR2_EXTERNAL_SURFACE_PATH)/board/surface-go1/users.txt"
BR2_ROOTFS_POST_BUILD_SCRIPT="$(BR2_EXTERNAL_SURFACE_PATH)/board/surface-go1/post-build.sh"
BR2_ROOTFS_POST_IMAGE_SCRIPT="$(BR2_EXTERNAL_SURFACE_PATH)/board/surface-go1/post-image.sh"
BR2_LINUX_KERNEL=y
BR2_LINUX_KERNEL_CUSTOM_VERSION=y
BR2_LINUX_KERNEL_CUSTOM_VERSION_VALUE="6.12.118"
BR2_LINUX_KERNEL_USE_CUSTOM_CONFIG=y
BR2_LINUX_KERNEL_CUSTOM_CONFIG_FILE="board/pc/linux.config"
BR2_LINUX_KERNEL_CONFIG_FRAGMENT_FILES="$(BR2_EXTERNAL_SURFACE_PATH)/board/surface-go1/linux.fragment"
BR2_LINUX_KERNEL_NEEDS_HOST_OPENSSL=y
BR2_LINUX_KERNEL_NEEDS_HOST_LIBELF=y
BR2_PACKAGE_SURFACE_SHELL=y
BR2_PACKAGE_SURFACE_EMULATORS=y
BR2_PACKAGE_MESA3D=y
BR2_PACKAGE_MESA3D_GALLIUM_DRIVER_SOFTPIPE=y
BR2_PACKAGE_MESA3D_OPENGL_EGL=y
BR2_PACKAGE_MESA3D_OPENGL_ES=y
BR2_PACKAGE_WESTON=y
BR2_PACKAGE_WESTON_DEFAULT_DRM=y
BR2_PACKAGE_WESTON_SHELL_KIOSK=y
# BR2_PACKAGE_WESTON_SHELL_DESKTOP is not set
# BR2_PACKAGE_WESTON_SHELL_FULLSCREEN is not set
# BR2_PACKAGE_WESTON_SHELL_IVI is not set
# BR2_PACKAGE_WESTON_SCREENSHARE is not set
BR2_PACKAGE_LIBDRM_INTEL=y
BR2_PACKAGE_BLUEZ5_UTILS=y
BR2_PACKAGE_BLUEZ5_UTILS_CLIENT=y
BR2_PACKAGE_CA_CERTIFICATES=y
BR2_PACKAGE_OPENSSL=y
BR2_PACKAGE_LIBCURL=y
BR2_PACKAGE_LIBCURL_CURL=y
BR2_PACKAGE_LIBCURL_OPENSSL=y
BR2_PACKAGE_ALSA_UTILS=y
BR2_PACKAGE_ALSA_UTILS_APLAY=y
BR2_PACKAGE_UTIL_LINUX=y
BR2_PACKAGE_E2FSPROGS=y
BR2_PACKAGE_E2FSPROGS_RESIZE2FS=y
BR2_TARGET_ROOTFS_EXT2=y
BR2_TARGET_ROOTFS_EXT2_4=y
BR2_TARGET_ROOTFS_EXT2_SIZE="2048M"
# BR2_TARGET_ROOTFS_TAR is not set
BR2_TARGET_GRUB2=y
BR2_TARGET_GRUB2_X86_64_EFI=y
BR2_PACKAGE_HOST_DOSFSTOOLS=y
BR2_PACKAGE_HOST_GENIMAGE=y
BR2_PACKAGE_HOST_MTOOLS=y

BR2_PACKAGE_XORG7=y
BR2_PACKAGE_MESA3D_OPENGL_GLX=y
BR2_PACKAGE_LIBEPOXY=y
BR2_PACKAGE_WESTON_XWAYLAND=y
BR2_PACKAGE_FFMPEG=y
BR2_PACKAGE_FFMPEG_SWSCALE=y
BR2_PACKAGE_SURFACE_TAILSCALE=y
BR2_PACKAGE_SURFACE_MOONLIGHT=y
BR2_PACKAGE_SDL2=y
BR2_PACKAGE_SDL2_OPENGLES=y
BR2_PACKAGE_SDL2_WAYLAND=y
BR2_PACKAGE_AVAHI=y
BR2_PACKAGE_AVAHI_DAEMON=y
BR2_PACKAGE_DBUS=y
BR2_PACKAGE_OPUS=y
BR2_PACKAGE_LIBEVDEV=y
BR2_PACKAGE_UTIL_LINUX_LIBUUID=y
BR2_PACKAGE_WPEWEBKIT=y
BR2_PACKAGE_GLIB_NETWORKING=y
BR2_PACKAGE_WPEWEBKIT_SANDBOX=y
BR2_PACKAGE_WPEWEBKIT_MULTIMEDIA=y
BR2_PACKAGE_COG=y
BR2_PACKAGE_COG_PLATFORM_FDO=y
BR2_PACKAGE_COG_PROGRAMS_HOME_URI="https://www.google.com/"
BR2_PACKAGE_DEJAVU=y
BR2_PACKAGE_PYTHON3=y
BR2_PACKAGE_PYTHON3_SSL=y
BR2_PACKAGE_PYTHON3_ZLIB=y
BR2_PACKAGE_FONTCONFIG=y
BR2_PACKAGE_XLIB_LIBX11=y
BR2_PACKAGE_XLIB_LIBXEXT=y
BR2_PACKAGE_XLIB_LIBXI=y
BR2_PACKAGE_XLIB_LIBXRENDER=y
BR2_PACKAGE_XLIB_LIBXTST=y
BR2_PACKAGE_WPA_SUPPLICANT=y
BR2_PACKAGE_WPA_SUPPLICANT_CLI=y
BR2_PACKAGE_WPA_SUPPLICANT_PASSPHRASE=y
BR2_PACKAGE_IW=y
BR2_PACKAGE_ALSA_UTILS_AMIXER=y
BR2_PACKAGE_OVERRIDE_FILE="$(BR2_EXTERNAL_SURFACE_PATH)/host-toolchain-overrides.mk"
BR2_PACKAGE_MESA3D_GALLIUM_DRIVER_IRIS=y
BR2_PACKAGE_MESA3D_VULKAN_DRIVER_INTEL=y
BR2_PACKAGE_VULKAN_TOOLS=y
BR2_PACKAGE_INTEL_MEDIADRIVER=y
BR2_PACKAGE_LIBVA_UTILS=y
BR2_PACKAGE_LINUX_FIRMWARE=y
BR2_PACKAGE_LINUX_FIRMWARE_I915=y
BR2_PACKAGE_LINUX_FIRMWARE_QUALCOMM_6174=y
BR2_PACKAGE_LINUX_FIRMWARE_QUALCOMM_6174A_BT=y
BR2_PACKAGE_WIRELESS_REGDB=y
BR2_PACKAGE_WPA_SUPPLICANT_NL80211=y
BR2_PACKAGE_WPA_SUPPLICANT_WPA3=y
BR2_PACKAGE_ALSA_UTILS_ALSACTL=y
BR2_PACKAGE_PYTHON_PILLOW=y
BR2_PACKAGE_SURFACE_WINE64=y
BR2_PACKAGE_SURFACE_UMU=y
BR2_PACKAGE_UTIL_LINUX_BINARIES=y
BR2_PACKAGE_UTIL_LINUX_MOUNT=y
```

## external/package/surface-emulators/Config.in
```kconfig
menu "Surface emulator engines"

depends on BR2_x86_64

depends on BR2_INSTALL_LIBSTDCPP

depends on BR2_TOOLCHAIN_HAS_THREADS

depends on !BR2_STATIC_LIBS

config BR2_PACKAGE_SURFACE_EMULATORS
    bool "Build every default Surface emulator engine"
    depends on BR2_PACKAGE_HAS_LIBGLES
    depends on BR2_PACKAGE_HAS_LIBEGL
    depends on BR2_PACKAGE_HAS_LIBGL
    depends on BR2_PACKAGE_HAS_UDEV
    depends on BR2_PACKAGE_XORG7
    select BR2_PACKAGE_SURFACE_FCEUMM
    select BR2_PACKAGE_SURFACE_SNES9X
    select BR2_PACKAGE_SURFACE_GAMBATTE
    select BR2_PACKAGE_SURFACE_MGBA
    select BR2_PACKAGE_SURFACE_GENESIS_PLUS_GX
    select BR2_PACKAGE_SURFACE_PCSX_REARMED
    select BR2_PACKAGE_SURFACE_MUPEN64PLUS_NEXT
    select BR2_PACKAGE_SURFACE_MELONDS_DS
    select BR2_PACKAGE_SURFACE_FLYCAST
    select BR2_PACKAGE_SURFACE_PPSSPP
    select BR2_PACKAGE_SURFACE_DOLPHIN
    help
      Native emulator engines for the Surface HOME library. No games,
      proprietary BIOS, firmware dumps or third-party artwork are included.
      Actual game execution requires the libretro host or Dolphin frontend.

config BR2_PACKAGE_SURFACE_FCEUMM
    bool "FCEUmm (NES)"

config BR2_PACKAGE_SURFACE_SNES9X
    bool "Snes9x (SNES)"

config BR2_PACKAGE_SURFACE_GAMBATTE
    bool "Gambatte (GB/GBC)"

config BR2_PACKAGE_SURFACE_MGBA
    bool "mGBA (Game Boy Advance)"

config BR2_PACKAGE_SURFACE_GENESIS_PLUS_GX
    bool "Genesis Plus GX (Mega Drive/Genesis)"

config BR2_PACKAGE_SURFACE_PCSX_REARMED
    bool "PCSX ReARMed (PlayStation)"

config BR2_PACKAGE_SURFACE_MUPEN64PLUS_NEXT
    bool "Mupen64Plus Next (Nintendo 64)"
    depends on BR2_PACKAGE_HAS_LIBGLES

config BR2_PACKAGE_SURFACE_MELONDS_DS
    bool "melonDS DS (Nintendo DS)"
    help
      Maintained melonDS DS core with x86-64 JIT and threaded software
      rendering. All upstream CMake FetchContent dependencies are fixed
      revisions downloaded and hashed before configuration.

config BR2_PACKAGE_SURFACE_FLYCAST
    bool "Flycast (Dreamcast)"
    depends on BR2_PACKAGE_HAS_LIBGLES
    select BR2_PACKAGE_LIBZIP
    select BR2_PACKAGE_LIBMINIUPNPC
    help
      Official Flycast 2.7 libretro core with GLES3 presentation.

config BR2_PACKAGE_SURFACE_PPSSPP
    bool "PPSSPP (PlayStation Portable)"
    depends on BR2_PACKAGE_HAS_LIBGLES
    select BR2_PACKAGE_ZLIB
    select BR2_PACKAGE_LIBPNG
    select BR2_PACKAGE_ZSTD
    select BR2_PACKAGE_FFMPEG
    select BR2_PACKAGE_FFMPEG_SWSCALE
    select BR2_PACKAGE_LIBCURL
    help
      Official complete PPSSPP 1.20.4 source release, built as a libretro
      core with GLES and FFmpeg. Its assets are installed separately at
      /usr/share/surface/system/PPSSPP; the frontend must expose that
      directory as PPSSPP under its libretro system directory.

config BR2_PACKAGE_SURFACE_DOLPHIN
    bool "Dolphin standalone (GameCube)"
    depends on BR2_PACKAGE_HAS_LIBEGL
    depends on BR2_PACKAGE_HAS_LIBGL
    depends on BR2_PACKAGE_HAS_UDEV
    depends on BR2_PACKAGE_XORG7
    select BR2_PACKAGE_SURFACE_SDL3
    select BR2_PACKAGE_ALSA_LIB
    select BR2_PACKAGE_LIBEVDEV
    select BR2_PACKAGE_LIBUSB
    select BR2_PACKAGE_LIBCURL
    select BR2_PACKAGE_BZIP2
    select BR2_PACKAGE_XLIB_LIBX11
    select BR2_PACKAGE_XLIB_LIBXI
    select BR2_PACKAGE_XLIB_LIBXRANDR
    help
      Actual standalone dolphin-emu-nogui graphical frontend, with SDL3
      controllers and ALSA sound. Its X11 window uses Weston Xwayland;
      upstream NoGUI has no native Wayland window frontend. Requires
      the desktop GL/EGL profile in emulators.fragment. No Qt is built.

endmenu
```

## external/package/surface-moonlight/Config.in
```kconfig
config BR2_PACKAGE_SURFACE_MOONLIGHT
	bool "Surface Moonlight Embedded (Wayland/SDL2)"
	depends on BR2_x86_64
	depends on BR2_USE_MMU
	depends on BR2_TOOLCHAIN_HAS_THREADS
	depends on !BR2_STATIC_LIBS
	depends on BR2_PACKAGE_HAS_UDEV
	depends on BR2_PACKAGE_HAS_LIBEGL
	depends on BR2_PACKAGE_HAS_LIBGLES
	depends on BR2_PACKAGE_WAYLAND
	select BR2_PACKAGE_ALSA_LIB
	select BR2_PACKAGE_AVAHI
	select BR2_PACKAGE_AVAHI_DAEMON
	select BR2_PACKAGE_DBUS
	select BR2_PACKAGE_EXPAT
	select BR2_PACKAGE_FFMPEG
	select BR2_PACKAGE_LIBCURL
	select BR2_PACKAGE_LIBCURL_OPENSSL
	select BR2_PACKAGE_LIBEVDEV
	select BR2_PACKAGE_OPENSSL
	select BR2_PACKAGE_OPUS
	select BR2_PACKAGE_SDL2
	select BR2_PACKAGE_SDL2_OPENGLES
	select BR2_PACKAGE_SDL2_WAYLAND
	select BR2_PACKAGE_UTIL_LINUX
	select BR2_PACKAGE_UTIL_LINUX_LIBUUID
	help
	  Pinned upstream Moonlight Embedded client with its SDL2 Wayland
	  frontend, FFmpeg software video decoding, Opus audio, and gamepad
	  input. Hardware accelerated decoding remains unverified.
	  Pairing requires an authorized Sunshine/GameStream PC.

	  https://github.com/moonlight-stream/moonlight-embedded
```

## external/package/surface-rotation/Config.in
```kconfig
config BR2_PACKAGE_SURFACE_ROTATION
    bool "Surface live display rotation"
    depends on BR2_PACKAGE_WESTON
    help
      Apply sensor-driven output rotation through the compositor without
      restarting HOME or the running application.
```

## external/package/surface-sdl3/Config.in
```kconfig
config BR2_PACKAGE_SURFACE_SDL3
    bool "Surface SDL3 (Wayland/EGL foundation)"
    depends on BR2_INSTALL_LIBSTDCPP
    depends on BR2_TOOLCHAIN_HAS_THREADS
    depends on BR2_USE_WCHAR
    depends on !BR2_STATIC_LIBS
    depends on !BR2_PACKAGE_SDL3
    select BR2_PACKAGE_WAYLAND
    select BR2_PACKAGE_WAYLAND_PROTOCOLS
    select BR2_PACKAGE_LIBXKBCOMMON
    help
      Pinned SDL3 3.4.20 with Wayland and EGL/GLES presentation.
      The first profile uses Mesa softpipe, with no claim of Intel
      hardware acceleration. Do not enable alongside upstream SDL3.
```

## external/package/surface-shell/Config.in
```kconfig
config BR2_PACKAGE_SURFACE_SHELL
    bool "Surface HOME shell"
    depends on BR2_INSTALL_LIBSTDCPP
    select BR2_PACKAGE_SURFACE_SDL3
```

## external/package/surface-tailscale/Config.in
```kconfig
config BR2_PACKAGE_SURFACE_TAILSCALE
	bool "Surface Tailscale client and daemon"
	depends on BR2_x86_64
	depends on !BR2_PACKAGE_TAILSCALE
	depends on BR2_USE_WCHAR
	depends on BR2_TOOLCHAIN_HEADERS_AT_LEAST_3_12
	select BR2_PACKAGE_CA_CERTIFICATES
	select BR2_PACKAGE_NFTABLES
	help
	  Official pinned static x86-64 Tailscale binaries. The daemon starts
	  with private persistent state in /data/tailscale. Device enrollment
	  requires the owner's interactive login; no credentials are embedded.

	  https://tailscale.com/
```

## external/package/surface-umu/Config.in
```kconfig
config BR2_PACKAGE_SURFACE_UMU
    bool "UMU Proton launcher"
    depends on BR2_x86_64
    depends on BR2_TOOLCHAIN_USES_GLIBC
    depends on BR2_USE_MMU
    select BR2_PACKAGE_BUSYBOX_SHOW_OTHERS
    select BR2_PACKAGE_PYTHON3
    select BR2_PACKAGE_PYTHON3_SSL
    select BR2_PACKAGE_PYTHON3_ZLIB
    select BR2_PACKAGE_PYTHON3_PYEXPAT
    select BR2_PACKAGE_PYTHON3_BZIP2
    select BR2_PACKAGE_PYTHON3_XZ
    select BR2_PACKAGE_BASH
    select BR2_PACKAGE_CA_CERTIFICATES
    help
      The official checksum-pinned UMU launcher and vendored Python modules.
      Proton and its Steam Linux Runtime are fetched only through explicit
      first-run setup into private writable storage, never at boot.
      This package does not establish Windows game compatibility.
```

## external/package/surface-wine64/Config.in
```kconfig
config BR2_PACKAGE_SURFACE_WINE64
    bool "Surface Wine 11.0 (Windows x86-64)"
    depends on BR2_x86_64
    depends on BR2_HOSTARCH = "x86_64"
    depends on BR2_TOOLCHAIN_HAS_THREADS_NPTL
    depends on BR2_TOOLCHAIN_USES_GLIBC
    depends on BR2_USE_WCHAR
    depends on !BR2_STATIC_LIBS
    depends on !BR2_PACKAGE_WINE
    depends on BR2_PACKAGE_XORG7
    depends on BR2_PACKAGE_HAS_LIBGL
    depends on BR2_PACKAGE_HAS_UDEV
    select BR2_PACKAGE_ALSA_LIB
    select BR2_PACKAGE_ALSA_LIB_PCM
    select BR2_PACKAGE_ALSA_LIB_SEQ
    select BR2_PACKAGE_ALSA_LIB_RAWMIDI
    select BR2_PACKAGE_FONTCONFIG
    select BR2_PACKAGE_FREETYPE
    select BR2_PACKAGE_GNUTLS
    select BR2_PACKAGE_LIBUSB
    select BR2_PACKAGE_VULKAN_HEADERS
    select BR2_PACKAGE_VULKAN_LOADER
    select BR2_PACKAGE_SDL2
    select BR2_PACKAGE_XLIB_LIBX11
    select BR2_PACKAGE_XLIB_LIBXCOMPOSITE
    select BR2_PACKAGE_XLIB_LIBXCURSOR
    select BR2_PACKAGE_XLIB_LIBXEXT
    select BR2_PACKAGE_XLIB_LIBXFIXES
    select BR2_PACKAGE_XLIB_LIBXI
    select BR2_PACKAGE_XLIB_LIBXINERAMA
    select BR2_PACKAGE_XLIB_LIBXRANDR
    select BR2_PACKAGE_XLIB_LIBXRENDER
    select BR2_PACKAGE_XLIB_LIBXXF86VM
    help
      Actual 64-bit Wine runtime for unchanged owner-imported Windows
      x86-64 clients. Uses the upstream stable 11.0 source and Buildroot's
      matching host-wine build tools. X11/OpenGL windows run through
      Weston Xwayland; ALSA, TLS, USB and SDL controller support are built.

      This profile does not run 32-bit Windows applications. No Digimon
      client files, Windows runtime binaries, accounts or credentials ship.
      Client compatibility requires target execution tests.
```
